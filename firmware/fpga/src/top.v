/**
 * @file top.v
 * @brief Top-level module for the FPGA video display controller.
 *
 * This module integrates all subsystems for the Cyber-Mainframe game display:
 *   - PLL clock generation (24 MHz -> 33 MHz)
 *   - LCD timing controller (generates HSYNC, VSYNC, DE, pixel coordinates)
 *   - SPI slave receiver (reads game grid and HUD data from ESP32)
 *   - Hardware override state machine (auto-clear and auto-fill modes)
 *   - Dual-port framebuffer (BRAM) with multiplexed write port
 *   - Display compositor (renders grid, status bars, timer, invader icons)
 *
 * Physical pin connections are documented inline.
 *
 * @author  Saim Shujah
 * @date    2026-06-23
 * @version 1.0
 */

module top (
    // ------------------------------------------------------------------------
    // Clock and Reset
    // ------------------------------------------------------------------------
    input wire        ext_clk_24m,   // Physical Pin 35: 24 MHz external oscillator
    input wire        ext_rst_n,     // Physical Pin 14: Active-low reset button

    // ------------------------------------------------------------------------
    // Dedicated SPI Port Channels from ESP32
    // ------------------------------------------------------------------------
    input wire        esp_sclk,      // Physical Pin 22: SPI clock
    input wire        esp_spi_mosi,  // Physical Pin 23: SPI master-out, slave-in (data)
    input wire        esp_spi_cs,    // Physical Pin 24: SPI chip-select (active-low)

    // ------------------------------------------------------------------------
    // LCD Video Output Panels
    // ------------------------------------------------------------------------
    output wire        lcd_pixel_clk, // Physical Pin 11: Pixel clock (33 MHz)
    output wire        lcd_hsync,     // Physical Pin 10: Horizontal sync
    output wire        lcd_vsync,     // Physical Pin 46: Vertical sync
    output wire        lcd_video_de,  // Physical Pin 5:  Data enable
    output wire [4:0]  lcd_r,         // Pins 31 to 27: Red colour (5 bits)
    output wire [5:0]  lcd_g,         // Pins 40 to 32: Green colour (6 bits)
    output wire [4:0]  lcd_b,         // Pins 45 to 41: Blue colour (5 bits)

    // ------------------------------------------------------------------------
    // PS-RAM Chip Select (forced high to disable)
    // ------------------------------------------------------------------------
    output wire psram_cs_n
);

    // =========================================================================
    // 1. CLOCK & TIMING MANAGEMENT BLOCK
    // =========================================================================

    // Internal clock signals
    wire clk_33m;         // 33 MHz pixel clock generated by PLL
    wire rpll_lock;       // PLL lock indicator (active-high)

    // Force PS-RAM chip-select high to keep the external RAM completely disabled.
    assign psram_cs_n = 1'b1;

    // Instantiate the Gowin PLL to multiply 24 MHz to 33 MHz.
    Gowin_rPLL u_pll (
        .clkin(ext_clk_24m),   // 24 MHz input from external oscillator
        .clkout(clk_33m),      // 33 MHz output for pixel clock and logic
        .lock(rpll_lock)       // Lock signal
    );

    // Drive the physical LCD pixel clock directly with the PLL output.
    assign lcd_pixel_clk = clk_33m;

    // Global reset: active-low, asserted when either the physical button is low
    // or the PLL is not locked.
    wire global_reset_n;
    assign global_reset_n = ext_rst_n && rpll_lock;

    // Scanline coordinate buses from the timing controller.
    wire [9:0] w_pixel_x;
    wire [9:0] w_pixel_y;
    wire       w_video_de;

    // Internal colour buses from the compositor to the output pins.
    wire [4:0] comp_r;
    wire [5:0] comp_g;
    wire [4:0] comp_b;

    // Instantiate the LCD timing generator.
    lcd_timing u_timing (
        .clk_33m      (clk_33m),
        .rst_n        (global_reset_n),
        .hsync        (lcd_hsync),
        .vsync        (lcd_vsync),
        .video_de     (w_video_de),
        .pixel_x      (w_pixel_x),
        .pixel_y      (w_pixel_y),
        .frame_done   ()   // Unused, left open
    );


    // =========================================================================
    // 2. SPI RECEIVER CORE & HARDWARE OVERRIDE CONTROLLER
    // =========================================================================

    // Buses from the SPI receiver module.
    wire [12:0] spi_rx_addr;      // Address within the 5600-byte framebuffer
    wire [3:0]  spi_rx_data;      // 4-bit cell colour value (0 = empty, 1-4 = teams)
    wire        spi_raw_toggle;   // Indicates a new valid SPI transfer

    // HUD configuration registers extracted from the SPI stream.
    wire [1:0]  core_game_mode;   // Game mode (0..2)
    wire [6:0]  core_p1_status;   // Player 1 status (0-100)
    wire [6:0]  core_p2_status;
    wire [6:0]  core_p3_status;
    wire [6:0]  core_p4_status;
    wire [5:0]  core_time_mins;   // Match minutes (0-59)
    wire [5:0]  core_time_secs;   // Match seconds (0-59)

    // 16-bit composite for invader IDs (4 bits per player) – or winner ID in fill mode.
    wire [15:0] core_invader_composite;

    // Hardware override command signals.
    wire        rx_cmd_clear;     // Asserted when bit 7 of HUD byte 0 is set
    wire        rx_cmd_fill;      // Asserted when bit 6 of HUD byte 0 is set
    wire [2:0]  rx_winner_color;  // Winner colour ID (from byte 5609, bits [5:3])

    // Instantiate the SPI slave receiver.
    spi_grid_rx u_spi_interface (
        .spi_clk                (esp_sclk),
        .spi_mosi               (esp_spi_mosi),
        .spi_cs                 (esp_spi_cs),
        .rx_addr                (spi_rx_addr),
        .rx_data                (spi_rx_data),
        .data_toggle            (spi_raw_toggle),
        .hud_game_mode          (core_game_mode),
        .hud_p1_status          (core_p1_status),
        .hud_p2_status          (core_p2_status),
        .hud_p3_status          (core_p3_status),
        .hud_p4_status          (core_p4_status),
        .hud_time_mins          (core_time_mins),
        .hud_time_secs          (core_time_secs),
        .hud_invader_composite  (core_invader_composite),
        .cmd_clear_match        (rx_cmd_clear),
        .cmd_fill_winner        (rx_cmd_fill),
        .winner_color_id        (rx_winner_color)
    );

    // -------------------------------------------------------------------------
    // Hardware State Machine for Automatic Clear and Fill
    // -------------------------------------------------------------------------

    // Local constants for the three states.
    localparam STATE_PASSTHROUGH = 2'b00;   // Normal operation: SPI writes to RAM
    localparam STATE_AUTO_CLEAR  = 2'b01;   // Fast clear of entire framebuffer
    localparam STATE_AUTO_FILL   = 2'b10;   // Fast fill with winner colour

    reg [1:0]  hw_state   = STATE_PASSTHROUGH;   // Current state
    reg [12:0] hw_counter = 13'd0;               // Address counter for clear/fill loops

    // Synchronise command signals into the 33 MHz clock domain.
    reg        clear_triggered = 1'b0;
    reg        fill_triggered  = 1'b0;
    reg [3:0]  target_fill_id  = 4'd0;           // Winner colour ID padded to 4 bits

    always @(posedge clk_33m or negedge global_reset_n) begin
        if (!global_reset_n) begin
            clear_triggered <= 1'b0;
            fill_triggered  <= 1'b0;
            target_fill_id  <= 4'd0;
        end else begin
            // Latch the SPI command pulses.
            clear_triggered <= rx_cmd_clear;
            fill_triggered  <= rx_cmd_fill;
            // Pad the 3-bit winner ID to 4 bits (MSB zero) for RAM data width.
            target_fill_id  <= {1'b0, rx_winner_color};
        end
    end

    // Sequential state machine that walks through 5600 addresses for clear/fill.
    always @(posedge clk_33m or negedge global_reset_n) begin
        if (!global_reset_n) begin
            hw_state   <= STATE_PASSTHROUGH;
            hw_counter <= 13'd0;
        end else begin
            case (hw_state)
                STATE_PASSTHROUGH: begin
                    // Start clear or fill upon receiving the corresponding command.
                    if (clear_triggered) begin
                        hw_state   <= STATE_AUTO_CLEAR;
                        hw_counter <= 13'd0;
                    end else if (fill_triggered) begin
                        hw_state   <= STATE_AUTO_FILL;
                        hw_counter <= 13'd0;
                    end
                end

                STATE_AUTO_CLEAR: begin
                    // Count through all 5600 cells; when done, return to passthrough.
                    if (hw_counter >= 13'd5599) begin
                        hw_state <= STATE_PASSTHROUGH;
                    end else begin
                        hw_counter <= hw_counter + 13'd1;
                    end
                end

                STATE_AUTO_FILL: begin
                    // Similarly, count through all cells for the fill operation.
                    if (hw_counter >= 13'd5599) begin
                        hw_state <= STATE_PASSTHROUGH;
                    end else begin
                        hw_counter <= hw_counter + 13'd1;
                    end
                end

                default: hw_state <= STATE_PASSTHROUGH;
            endcase
        end
    end


    // =========================================================================
    // 3. FRAMEBUFFER CELL MEMORY BLOCK
    // =========================================================================

    // Port A: read address from compositor, read data returned.
    wire [12:0] video_ram_raddr;
    wire [3:0]  video_ram_rdata;

    // Port B: multiplexed write address, data, and enable.
    reg [12:0] multiplexed_waddr;
    reg [3:0]  multiplexed_wdata;
    reg        multiplexed_we;

    // Multiplex the Port B write interface based on the current hw_state.
    always @(*) begin
        case (hw_state)
            STATE_AUTO_CLEAR: begin
                // Write zeros to every address, one per clock cycle.
                multiplexed_we    = 1'b1;
                multiplexed_waddr = hw_counter;
                multiplexed_wdata = 4'd0;           // 0 = empty cell
            end
            STATE_AUTO_FILL: begin
                // Write the winner colour ID to every cell.
                multiplexed_we    = 1'b1;
                multiplexed_waddr = hw_counter;
                multiplexed_wdata = target_fill_id; // 1..4 = team colour
            end
            default: begin // STATE_PASSTHROUGH
                // Only allow SPI writes to addresses below 5600 (i.e., the playfield).
                // HUD bytes are not written to RAM; they go directly to HUD registers.
                multiplexed_we    = spi_raw_toggle && (spi_rx_addr < 13'd5600);
                multiplexed_waddr = spi_rx_addr;
                multiplexed_wdata = spi_rx_data;
            end
        endcase
    end

    // Instantiate the dual-port block RAM that holds the 100x56 game grid.
    mainframe_ram u_mainframe_buffer (
        .clk    (clk_33m),
        // Port A: read-only, used by the compositor for pixel rendering.
        .addr_a (video_ram_raddr),
        .dout_a (video_ram_rdata),
        // Port B: write-only (we do not use dout_b), with multiplexed control.
        .addr_b (multiplexed_waddr),
        .din_b  (multiplexed_wdata),
        .we_b   (multiplexed_we),
        .dout_b ()   // Unused
    );


    // =========================================================================
    // 4. HIGH-TECH GRAPHICS DISPLAY COMPOSITOR
    // =========================================================================

    // Instantiate the display compositor which renders the final image.
    // It reads grid data from Port A, overlays HUD elements, and outputs RGB.
    display_compositor u_renderer (
        .pixel_x           (w_pixel_x),
        .pixel_y           (w_pixel_y),
        .video_de          (w_video_de),
        .grid_rd_addr      (video_ram_raddr),    // Address to fetch current pixel colour
        .grid_rd_data      (video_ram_rdata),    // Colour value for that cell
        .game_mode         (core_game_mode),
        .p1_status         (core_p1_status),
        .p2_status         (core_p2_status),
        .p3_status         (core_p3_status),
        .p4_status         (core_p4_status),
        .time_minutes      (core_time_mins),
        .time_seconds      (core_time_secs),
        .invader_composite (core_invader_composite),
        .final_r           (comp_r),
        .final_g           (comp_g),
        .final_b           (comp_b)
    );


    // =========================================================================
    // 5. DIRECT CONTINUOUS ASSIGNMENTS TO EXTERNAL PINS
    // =========================================================================

    // Drive the LCD colour buses from the compositor outputs.
    assign lcd_r        = comp_r;
    assign lcd_g        = comp_g;
    assign lcd_b        = comp_b;

    // Pass the video data enable signal directly to the output pin.
    assign lcd_video_de = w_video_de;

endmodule